/*
 * _1Hz_asm_int.asm
 *
 */
 .EQU REPEAT = 100
 .EQU MASK = (1<<6)
 .INCLUDE<M88DEF.INC>
.ORG 0
	RJMP RESET
.ORG 0X001C
	RJMP TIM0_COMPA
.ORG 0x100
RESET:
	LDI R16, HIGH(RAMEND)
	OUT SPH, R16
	LDI R16, LOW(RAMEND)
	OUT SPL, R16
	LDI R16, MASK
	LDI R17, MASK
	LDI R18, REPEAT
	SBI DDRD, 6
	CBI PORTD, 6
	RCALL INTRUP_10ms
	RJMP MAIN

;--- 10ms Setup
INTRUP_10ms:
	LDI R19, (1<<OCIE0A) ;enable OCR0A interrupt
	STS TIMSK0, R19
	LDI R19, 156 ;OCR0A
	OUT OCR0A, R19
	LDI R19, (1<<WGM01) ;CTC
	OUT TCCR0A, R19
	LDI R19, (1<<CS02) ; N prescaler (1<<CS02)
	OUT TCCR0B, R19
	SEI

MAIN:
	RJMP MAIN

INIC:
	LDI R18, REPEAT
	EOR R16, R17
	OUT PORTD, R16

TIM0_COMPA:
	DEC R18
	BREQ INIC
	RETI
;EOF
